## components/dht20/Kconfig
```kconfig
menu "DHT20 Setup"
    config DHT20_SENSOR_ENABLED
        bool "Enable DHT20 Temperature and Humidity sensor."
        depends on TOOLBOX_ENABLED

    if DHT20_SENSOR_ENABLED
        config I2C_ADDRESS
            hex "DHT20 I2C Address"
            default 0x38
    endif
endmenu
```

## components/toolbox/Kconfig
```kconfig
menu "TOOLBOX SETUP"
    config TOOLBOX_ENABLED
        bool "Enable Toolbox functions"

    if TOOLBOX_ENABLED
        config ENABLE_I2C
            bool "Enable I2C Bus communication"
            if ENABLE_I2C
                config I2C_PORT_NUM
                    int "I2C Master Port"
                    default 0
                config I2C_GPIO_SCL
                    int "GPIO For I2C SCL"
                    default 36
                config I2C_GPIO_SDA
                    int "GPIO For I2C SDA"
                    default 35
                config I2C_GPIO_SCL_PULLUP
                    bool "Enable SCL Pullup resistor"
                    default false
                config I2C_GPIO_SDA_PULLUP
                    bool "Enable SDA Pullup resistor"
                    default false
                config I2C_MASTER_FREQUENCY
                    int "I2C Clock frequency"
                    default 400000
                config I2C_BUS_TIMEOUT
                    int "Wait for response (ms)"
                    default 200
            endif
    endif
endmenu
```
